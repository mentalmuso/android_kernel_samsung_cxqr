## arch/arm64/Kconfig.projects
```kconfig
config SEC_Y2Q_PROJECT
	default n
	bool "Samsung Y2Q Project"
	help
	  Support for Samsung Y2Q Project

config MACH_Y2Q_USA_SINGLE
	default n
	bool "Samsung Y2Q USA SQ"
	help
	  Support for Samsung Y2Q USA SQ device.

config SEC_C1Q_PROJECT
	depends on ARCH_KONA
	default n
	bool "Samsung C1Q Project"
	help
	  Support for Samsung C1Q Project

config SEC_C2Q_PROJECT
	depends on ARCH_KONA
	default n
	bool "Samsung C2Q Project"
	help
	  Support for Samsung C2Q Project

menu "Samsung Canvas"
depends on SEC_C1Q_PROJECT || SEC_C2Q_PROJECT
source "arch/arm64/Kconfig.canvas"
endmenu
```
